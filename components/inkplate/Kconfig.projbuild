## components/inkplate/Kconfig.projbuild
```kconfig
menu "Inkplate Board"

choice INKPLATE_BOARD
    prompt "Board"

    config INKPLATE_BOARD_INKPLATE2
        bool "Inkplate2"

    config INKPLATE_BOARD_INKPLATE4
        bool "Inkplate4"

    config INKPLATE_BOARD_INKPLATE5
        bool "Inkplate5"

    config INKPLATE_BOARD_INKPLATE6
        bool "Inkplate6"

    config INKPLATE_BOARD_INKPLATE10
        bool "Inkplate10"

endchoice

endmenu

menu "WiFi Configuration"

config WIFI_SSID
	string "WiFi SSID"
	default ""

config WIFI_PASSWORD
	string "WiFi Password"
	default ""

endmenu
```
