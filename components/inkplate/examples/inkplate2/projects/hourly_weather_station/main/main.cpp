/**
 * @file        main.cpp
 * @author      Fran Fodor for Soldered
 * @brief       Hourly weather station using OpenWeatherMap (Inkplate 2).
 *
 * @details     Demonstrates a small battery-friendly weather dashboard for
 *              Inkplate 2. On every wake-up the board connects to WiFi,
 *              synchronizes time via NTP, fetches an hourly forecast from
 *              the OpenWeatherMap "onecall" API for a configured
 *              latitude/longitude, and renders three panels: the current
 *              temperature/icon and the next two hours. The board then goes
 *              into deep sleep and repeats the whole cycle after
 *              DELAY_MS milliseconds (deep sleep resets the ESP32, so
 *              execution always restarts from app_main()).
 *
 * Requirements:
 * - Board:      Soldered Inkplate 2
 * - Framework:  ESP-IDF v6.x
 * - Hardware:   Inkplate 2, USB cable
 * - Extra:      Stable WiFi connection, OpenWeatherMap API key
 *
 * Configuration:
 * - Menuconfig -> Inkplate Boards -> Inkplate2
 * - Menuconfig -> WiFi Configuration -> Enter your SSID and password
 * - main.cpp   -> API_KEY: your OpenWeatherMap API key
 * - main.cpp   -> LOCATION_LAT / LOCATION_LON: coordinates for your location
 *
 * How to use:
 * 1) Create a free OpenWeatherMap API key at https://openweathermap.org/guide
 *    (the "One Call API 3.0" plan is required) and paste it into API_KEY.
 * 2) Set LOCATION_LAT / LOCATION_LON to your location's coordinates.
 * 3) Configure WiFi credentials via menuconfig.
 * 4) Build and flash to Inkplate 2.
 * 5) The board fetches data, renders the dashboard, deep sleeps, and repeats.
 *
 * Expected output:
 * - Display: three framed panels showing "Now" and the next two hour
 *   labels, a temperature value (degC by default) and a small weather icon
 *   per panel.
 * - On WiFi failure: an error message is shown, then the board deep sleeps
 *   briefly before retrying.
 * - Serial Monitor: WiFi/NTP status and weather fetch retries (if any).
 *
 * Notes:
 * - Display uses the Inkplate 2 tri-color palette (INKPLATE2_BLACK /
 *   INKPLATE2_WHITE / INKPLATE2_RED) and a full refresh each cycle.
 * - Only the small (48x48, "_S_") monochrome icon variants from the
 *   original Arduino project are ported - the full-size color icon headers
 *   were unused by the sketch and dropped to avoid bloating the firmware
 *   image (see icons.h).
 * - Unlike the original sketch (which retries forever on a fetch failure),
 *   this port gives up after a handful of retries per wake cycle so a
 *   misconfigured API key/location cannot hang the board awake and drain
 *   the battery; it will simply try again on the next scheduled wake-up.
 * - The original sketch's WiFi-retry sleep passed seconds where the
 *   underlying API expects microseconds (effectively sleeping 10ms instead
 *   of 10s); this port converts DELAY_WIFI_RETRY_MS correctly.
 * - API rate limits apply - verify your current OpenWeatherMap quota before
 *   lowering DELAY_MS.
 * - Icons are selected by matching OpenWeatherMap condition abbreviations
 *   (e.g. "01d", "10n") against the built-in icon table.
 *
 * Docs:         https://docs.soldered.com/inkplate
 * Support:      https://forum.soldered.com/
 * Image tool:   https://tools.soldered.com/tools/image-converter/
 */

#include "sdkconfig.h"

#ifndef CONFIG_INKPLATE_BOARD_INKPLATE2
#error                                                                         \
    "Wrong board selection for this example, please select Inkplate2 in the boards menu."
#endif

#include "Inkplate.h"
#include "NetworkFunctions.h"

// Custom font used for the panel labels
#include "Fonts/SourceSansPro_Regular8pt7b.h"

// Small (48x48) weather condition icons generated by iconConvert.py
#include "icons.h"

#include "esp_log.h"
#include "esp_sleep.h"
#include "freertos/FreeRTOS.h"
#include "freertos/task.h"

#include <string.h>
#include <time.h>

static const char *TAG = "WEATHER_STATION";

// Delay between full refresh cycles (deep sleep). Kept in milliseconds to
// mirror the original sketch's DELAY_MS constant.
#define DELAY_MS (267800ULL)

// How long to deep sleep before retrying after a failed WiFi connection.
#define DELAY_WIFI_RETRY_MS (10ULL * 1000ULL)

// How many times to retry the weather fetch within a single wake cycle
// before giving up and going back to sleep (the original sketch retried
// forever, which could hang the board awake indefinitely - see Notes above).
#define MAX_FETCH_RETRIES 5

// TODO: fill in your OpenWeatherMap API key. Register for free (One Call API
// 3.0) at https://openweathermap.org/guide
#define API_KEY "YOUR_OPENWEATHERMAP_API_KEY"

// TODO: fill in the latitude/longitude of the location to show weather for
#define LOCATION_LAT "45.5510548"
#define LOCATION_LON "18.5947808"

// Uncomment for Fahrenheit output (also uncomment AMERICAN in
// NetworkFunctions.cpp)
// #define AMERICAN

// Weather icon abbreviation -> small (48x48) bitmap lookup table
static const char *s_abbrs[18] = {
    "01d", "02d", "03d", "04d", "09d", "10d", "11d", "13d", "50d",
    "01n", "02n", "03n", "04n", "09n", "10n", "11n", "13n", "50n",
};

static const uint8_t *s_icons[18] = {
    icon_s_01d, icon_s_02d, icon_s_03d, icon_s_04d, icon_s_09d, icon_s_10d, icon_s_11d, icon_s_13d, icon_s_50d,
    icon_s_01n, icon_s_02n, icon_s_03n, icon_s_04n, icon_s_09n, icon_s_10n, icon_s_11n, icon_s_13n, icon_s_50n,
};

// Draws the 48x48 icon matching abbr at (x, y), if found in the lookup table.
static void drawIcon(Inkplate &display, int16_t x, int16_t y, const char *abbr)
{
    for (int i = 0; i < 18; ++i)
    {
        if (strcmp(abbr, s_abbrs[i]) == 0)
        {
            display.drawBitmap(x, y, s_icons[i], 48, 48, INKPLATE2_BLACK, INKPLATE2_WHITE);
            return;
        }
    }
}

// Draws the three weather panels (rectangle + hour label + temperature +
// icon), mirroring the original sketch's drawTemps().
static void drawWeather(Inkplate &display, const char temps[3][8], const char hours[3][8], const char *abbr1,
                         const char *abbr2, const char *abbr3)
{
    // Draw the three panel outlines
    display.drawRect(5, 5, 60, 94, INKPLATE2_BLACK);
    display.drawRect(75, 5, 60, 94, INKPLATE2_BLACK);
    display.drawRect(145, 5, 60, 94, INKPLATE2_BLACK);

    display.setFont(&SourceSansPro_Regular8pt7b);
    display.setTextSize(1);
    display.setTextColor(INKPLATE2_RED, INKPLATE2_BLACK);

    // Hour labels: "Now" for the first panel, then the next two hours
    display.setCursor(18, 20);
    display.println("Now");

    display.setCursor(92, 20);
    display.println(hours[1]);

    display.setCursor(162, 20);
    display.println(hours[2]);

    // Temperature values
    display.setTextColor(INKPLATE2_BLACK, INKPLATE2_WHITE);

    display.setCursor(20, 40);
    display.print(temps[0]);
    display.println("C");

    display.setCursor(90, 40);
    display.print(temps[1]);
    display.println("C");

    display.setCursor(160, 40);
    display.print(temps[2]);
    display.println("C");

    // Weather condition icons
    drawIcon(display, 11, 48, abbr1);
    drawIcon(display, 81, 48, abbr2);
    drawIcon(display, 151, 48, abbr3);
}

// Clears the display, prints an error message, and deep sleeps for
// DELAY_WIFI_RETRY_MS before the ESP32 restarts and retries.
static void showErrorAndRetry(Inkplate &display, const char *message)
{
    display.clearDisplay();
    display.setTextSize(1);
    display.setCursor(0, 0);
    display.print(message);
    display.display();

    esp_sleep_enable_timer_wakeup(DELAY_WIFI_RETRY_MS * 1000ULL);
    esp_deep_sleep_start();
}

extern "C" void app_main(void)
{
    Inkplate display;

    // Initial cleaning of buffer and physical screen
    display.clearDisplay();

    // Connect Inkplate to WiFi (SSID/password come from menuconfig "WiFi
    // Configuration", never hardcode credentials here).
    display.wifi.begin();
    if (!display.wifi.waitForConnect(10000))
    {
        ESP_LOGE(TAG, "Unable to connect to WiFi");
        showErrorAndRetry(display, "Unable to connect to WiFi.\nPlease check SSID and PASS!");
        return; // unreachable, deep sleep restarts the chip
    }

    ESP_LOGI(TAG, "WiFi connected");

    // Synchronize time via NTP so hour labels can be computed
    display.wifi.setCurrentTime();
    time_t nowSec = time(nullptr);
    struct tm timeInfo;
    gmtime_r(&nowSec, &timeInfo);
    ESP_LOGI(TAG, "Current UTC time: %s", asctime(&timeInfo));

    display.clearDisplay();

    // Fetch weather data (retries a limited number of times, see
    // MAX_FETCH_RETRIES note above)
    NetworkFunctions network;
    char temps[3][8] = {"-", "-", "-"};
    char abbr1[16] = "01d";
    char abbr2[16] = "01d";
    char abbr3[16] = "01d";

    bool gotData = false;
    for (int attempt = 0; attempt < MAX_FETCH_RETRIES && !gotData; ++attempt)
    {
        gotData = network.getData(display.wifi, LOCATION_LON, LOCATION_LAT, API_KEY, temps[0], temps[1], temps[2],
                                   abbr1, abbr2, abbr3);
        if (!gotData)
        {
            ESP_LOGW(TAG, "Retrying weather fetch (%d/%d)...", attempt + 1, MAX_FETCH_RETRIES);
            vTaskDelay(pdMS_TO_TICKS(5000));
        }
    }

    if (!gotData)
        ESP_LOGE(TAG, "Giving up fetching weather data for this cycle");

    char hours[3][8] = {"", "", ""};
    network.getHours(hours[0], hours[1], hours[2]);

    // Draw the dashboard (shows "-" placeholders if the fetch above failed)
    drawWeather(display, temps, hours, abbr1, abbr2, abbr3);

    // Refresh the full screen
    display.display();

    // Go to sleep until the next scheduled refresh
    esp_sleep_enable_timer_wakeup(DELAY_MS * 1000ULL);
    esp_deep_sleep_start();
}
